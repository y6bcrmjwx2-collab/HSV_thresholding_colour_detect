## sdkconfig.defaults
```kconfig
CONFIG_IDF_TARGET="esp32s3"
CONFIG_IDF_TARGET_ESP32S3=y

CONFIG_ESP32S3_SPIRAM_SUPPORT=y
CONFIG_SPIRAM=y

# PSRAM type (Octal for ESP32-S3 with 8MB PSRAM)
CONFIG_SPIRAM_MODE_OCT=y
CONFIG_SPIRAM_TYPE_ESPPSRAM64=y
CONFIG_SPIRAM_SIZE=8388608

# Access method and allocation preference
CONFIG_SPIRAM_USE_CAPS_ALLOC=y
CONFIG_SPIRAM_TRY_ALLOCATE_FIRST=y

# Allow BSS segments in external memory (for large arrays)
CONFIG_SPIRAM_ALLOW_BSS_SEG_EXTERNAL_MEMORY=y


# Compulsory Cache Settings
CONFIG_SPIRAM_CACHE_WORKAROUND=y
CONFIG_SPIRAM_BANKSWITCH_ENABLE=y

# Heap Configuration for PSRAM
CONFIG_ESP32S3_HEAP_MIN_EXTRAM_THRESHOLD=1024

# Main Task Stack (for safety with large local vars)
CONFIG_ESP_MAIN_TASK_STACK_SIZE=8192
```
